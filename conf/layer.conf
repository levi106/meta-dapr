## conf/layer.conf
```bitbake
# We have a conf and classes directory, add to BBPATH
BBPATH .= ":${LAYERDIR}"

# We have recipes-* directories, add to BBFILES
BBFILES += "${LAYERDIR}/recipes-*/*/*.bb \
            ${LAYERDIR}/recipes-*/*/*.bbappend"

BBFILE_COLLECTIONS += "meta-dapr"
BBFILE_PATTERN_meta-dapr = "^${LAYERDIR}/"
BBFILE_PRIORITY_meta-dapr = "6"

LAYERDEPENDS_meta-dapr = "core"
LAYERSERIES_COMPAT_meta-dapr = "kirkstone"
```
